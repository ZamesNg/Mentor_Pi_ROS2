#include "mentor_pi_mcu/drivers/ssd1306.h"

#include <array>
#include <cstddef>
#include <cstdint>

namespace mentor_pi::mcu::drivers {
namespace {

using Glyph = std::array<std::uint8_t, 5>;

// Fixed 5x7 glyphs for the complete v2 OLED command alphabet, ordered from
// ASCII 0x20 (' ') through 0x7e ('~'). Keeping this table complete is part of
// the interface contract: a validated printable byte must never silently turn
// into another character on the display.
constexpr std::array<Glyph, 95> kPrintableAsciiGlyphs{{
    {0x00U, 0x00U, 0x00U, 0x00U, 0x00U},  // Space.
    {0x00U, 0x00U, 0x5fU, 0x00U, 0x00U},  // !
    {0x00U, 0x07U, 0x00U, 0x07U, 0x00U},  // "
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    {0x08U, 0x04U, 0x08U, 0x10U, 0x08U},  // ~
}};

Glyph LookupGlyph(char character) {
  const auto code = static_cast<unsigned char>(character);
  if (code >= 0x20U && code <= 0x7eU) {
    return kPrintableAsciiGlyphs[code - 0x20U];
  }
  return kPrintableAsciiGlyphs[static_cast<std::size_t>('?' - ' ')];
}

Result ToResult(IoStatus status, std::uint16_t detail = 0U) {
  switch (status) {
    case IoStatus::kOk:
      return OkResult();
    case IoStatus::kBusy:
      return {ResultCode::kBusy, detail};
    case IoStatus::kTimeout:
      return {ResultCode::kTimeout, detail};
    case IoStatus::kIoError:
      return {ResultCode::kIoError, detail};
  }
  return {ResultCode::kIoError, detail};
}

std::size_t AppendUnsigned(std::uint16_t value, char* output,
                           std::size_t capacity) {
  std::array<char, 5> reverse{};
  std::size_t digits = 0U;
  do {
    reverse[digits] = static_cast<char>('0' + (value % 10U));
    value = static_cast<std::uint16_t>(value / 10U);
    ++digits;
  } while (value != 0U && digits < reverse.size());
  const std::size_t count = digits < capacity ? digits : capacity;
  for (std::size_t index = 0; index < count; ++index) {
    output[index] = reverse[digits - index - 1U];
  }
  return count;
}

}  // namespace

Result Ssd1306Driver::Initialize(std::uint32_t deadline_ms) {
  constexpr std::array<std::uint8_t, 27> kInitialization{{
      0x00U, 0xaeU, 0xd5U, 0x80U, 0xa8U, 0x1fU, 0xd3U, 0x00U, 0x40U,
      0x8dU, 0x14U, 0x20U, 0x00U, 0xa1U, 0xc8U, 0xdaU, 0x02U, 0x81U,
      0x8fU, 0xd9U, 0xf1U, 0xdbU, 0x40U, 0xa4U, 0xa6U, 0xafU, 0x00U,
  }};
  const IoStatus status = i2c_.Write(kSsd1306Address, kInitialization.data(),
                                     kInitialization.size() - 1U, deadline_ms);
  if (status != IoStatus::kOk) {
    return ToResult(status, 1U);
  }
  initialized_ = true;
  Clear();
  return Flush(deadline_ms);
}

Result Ssd1306Driver::Render(const OledState& host_lines,
                             std::uint16_t battery_mv,
                             std::uint32_t deadline_ms) {
  if (!initialized_) {
    return {ResultCode::kBusy, 0};
  }
  Clear();
  DrawText(0U, host_lines.lines[0].bytes.data(), host_lines.lines[0].size);
  DrawText(1U, host_lines.lines[1].bytes.data(), host_lines.lines[1].size);
  if (battery_mv != 0U) {
    std::array<char, 16> battery{};
    constexpr std::array<char, 4> kPrefix{'B', 'A', 'T', ':'};
    std::size_t size = 0U;
    for (const char character : kPrefix) {
      battery[size] = character;
      ++size;
    }
    size += AppendUnsigned(battery_mv, &battery[size], battery.size() - size);
    battery[size++] = 'm';
    battery[size++] = 'V';
    // Preserve the legacy bottom-page placement. The two ROS-owned rows use
    // pages 0 and 1; page 2 remains blank so the local battery indication is
    // visually separated on page 3.
    DrawText(3U, battery.data(), size);
  }
  return Flush(deadline_ms);
}

void Ssd1306Driver::Clear() { framebuffer_.fill(0U); }

void Ssd1306Driver::DrawText(std::size_t page, const char* text,
                             std::size_t size) {
  if (page >= kSsd1306Height / 8U || text == nullptr) {
    return;
  }
  const std::size_t characters =
      size < kOledLineCapacity ? size : kOledLineCapacity;
  for (std::size_t index = 0; index < characters; ++index) {
    const Glyph glyph = LookupGlyph(text[index]);
    for (std::size_t column = 0; column < glyph.size(); ++column) {
      const std::size_t x = (index * glyph.size()) + column;
      if (x < kSsd1306Width) {
        framebuffer_[(page * kSsd1306Width) + x] = glyph[column];
      }
    }
  }
}

Result Ssd1306Driver::Flush(std::uint32_t deadline_ms) {
  constexpr std::array<std::uint8_t, 7> kAddressWindow{
      0x00U, 0x21U, 0x00U, 0x7fU, 0x22U, 0x00U, 0x03U};
  IoStatus status = i2c_.Write(kSsd1306Address, kAddressWindow.data(),
                               kAddressWindow.size(), deadline_ms);
  if (status != IoStatus::kOk) {
    return ToResult(status, 2U);
  }
  constexpr std::size_t kChunkSize = 32U;
  std::array<std::uint8_t, kChunkSize + 1U> packet{};
  packet[0] = 0x40U;
  for (std::size_t offset = 0; offset < framebuffer_.size();
       offset += kChunkSize) {
    for (std::size_t index = 0; index < kChunkSize; ++index) {
      packet[index + 1U] = framebuffer_[offset + index];
    }
    status =
        i2c_.Write(kSsd1306Address, packet.data(), packet.size(), deadline_ms);
    if (status != IoStatus::kOk) {
      return ToResult(status,
                      static_cast<std::uint16_t>(3U + (offset / kChunkSize)));
    }
  }
  return OkResult();
}

}  // namespace mentor_pi::mcu::drivers
